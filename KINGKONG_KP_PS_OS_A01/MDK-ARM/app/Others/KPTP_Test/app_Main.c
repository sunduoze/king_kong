/*
 * app_main.c
 *
 * Created on: 2017年11月14日
 * Author: Enzo
 */

#include "app_main.h"
//#include "stm32f1xx_hal.h"
//#include "spi.h"
//#include "MCP23S17.h"
//#include "bsp_delay.h"
//#include "stm_flash.h"

const uint8_t TEXT_Buffer[]={"STM32 FLASH TEST"};
#define SIZE sizeof(TEXT_Buffer)	 	//数组长度
uint8_t datatemp[SIZE];

#define FLASH_SAVE_ADDR  0X08020000 //起始地址从128kB/256K	//设置FLASH 保存地址(必须为偶数，且其值要大于本代码所占用FLASH的大小+0X08000000)
/*Flash = Code + Ro-data = 11336 +500 约 11.5kB*/


/*
void Stm_flashW(void)
{
	STMFLASH_Write(FLASH_SAVE_ADDR,(uint16_t*)TEXT_Buffer,SIZE);
}


void Stm_flashR(void)
{
	STMFLASH_Read(FLASH_SAVE_ADDR,(uint16_t*)datatemp,SIZE);
	printf("StorgeInfo:%s",datatemp);
}


void Test1(void)
{

	KeyBoardParameterPrint(&kb_X13_ANSI);
}*/


KeyBoard kb_X13_ANSI = {
/*ProN*/(uint8_t *)"X13 ANSI Single KeyStroke",
/*BtnTyp*/1,
/*Stdx*/ANSI,
/*OrgP*/{123,321},
/*Btn */{
/*
IO Expand Chip CS Pin [1:8]
IO Expand Chip Io     [0:7]
IO Expand Chip Part   0:A 1:B
____________________________________________
	MP_x:	Matrix Point Driver x-Axis
				or Single Point Deiver
	MP_y:	Matrix Point Driver y-Axis
	BP_X:	the X Axis Coordinate of ButtonPoint
	BP_Y:	the Y Axis Coordinate of ButtonPoint
____________________________________________
  MP_x          MP_y    BP_X BP_Y
  |               |      |    |
----------- ----------- --- ----					*/
0,0x01,0x12,0,0x01,0x12,824,987,
0,0x02,0x12,0,0x02,0x12,678,80,
0,0x04,0x12,0,0x04,0x12,329,573,
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5,0x08,0x12,5,0x08,0x12,984,914

}};


//typedef struct{/*KeyBoard*/
//	uint8_t          ProN[20];  //Project Name
//	uint8_t					 BtnTyp;		//Button Type 				1:single 0:matrix
//	KbProject				 Proj;	//KeyBoard Project		    Eg. X13 ...
//	KbStandard 			 Stdx;	//KeyBoard Standard 	    Eg. AINSI ISO JIS
//	ButtonPoint	     OrgP;	//Original Point Coordinate
//	Button     			 Btn[BUTTON_NUM];   //ButtonInfo  Include Button name & DrvPoint & Coodinate
//}KeyBoard;

/* KeyStorke Parameter Initlization */
void KeyBoardParameterInit(KeyBoard *kb, uint8_t *ProjName, uint8_t ButtonType, KbStandard Standard, ButtonPoint OriginalPoint, const Button *pBtn)
{
    static uint8_t i;
	kb->ProN = ProjName;
	kb->BtnTyp = ButtonType;
	kb->Stdx = Standard;
	kb->OrgP = OriginalPoint;
	//memcpy((kb->OrgP), pBtn, sizeof(Button));
	for( i = BUTTON_NUM; i > 0; i--)
	{
				kb->Btn[i] 	= *pBtn++;
	}
}

void KeyBoardParameterPrint(KeyBoard *kb)
{
	static uint8_t i;
	if(kb->BtnTyp)//1:single 0:matrix
	{
		printf("Single Point \r\n");
    printf("Name:%s Standard:%d  ORG_X:%d ORG_Y:%d \r\n", kb->ProN, kb->Stdx, kb->OrgP.AxisX,kb->OrgP.AxisY);
    printf("DrvP_Single_Cs: %d DrvP_Single_Io: %d MCP23S17Port: %d \r\n",kb->Btn[0].Drv[0].MCP23S17Cs, kb->Btn[0].Drv[0].MCP23S17Io, kb->Btn[0].Drv[0].MCP23S17Port);   printf("\r\n");
		for(i = 0; i < BUTTON_NUM; i++)
    {
			printf("DrvP_M0_Cs: %d DrvP_M0_Io: %d MCP23S17_M0: %d \r\n", kb->Btn[i].Drv[0].MCP23S17Cs, kb->Btn[i].Drv[0].MCP23S17Io, kb->Btn[i].Drv[0].MCP23S17Port);
			printf("DrvP_M0_Cs: %d DrvP_M0_Io: %d MCP23S17_M0: %d \r\n", kb->Btn[i].Drv[1].MCP23S17Cs, kb->Btn[i].Drv[1].MCP23S17Io, kb->Btn[i].Drv[1].MCP23S17Port);
			printf("%d     ", i);       printf("DrvPx: %d  DrvPy: %d \r\n", kb->Btn[i].BtnC.AxisX, kb->Btn[i].BtnC.AxisY);
		}
	}
	else
	{
		printf("Matrix Point \r\n");
		printf("Name:%s Standard:%d  ORG_X:%d ORG_Y:%d \r\n", kb->ProN, kb->Stdx, kb->OrgP.AxisX,kb->OrgP.AxisY);
    printf("\r\n");
    for(i = 0; i < BUTTON_NUM; i++)
    {
			printf("DrvP_M0_Cs: %d DrvP_M0_Io: %d MCP23S17_M0: %d \r\n", kb->Btn[i].Drv[0].MCP23S17Cs, kb->Btn[i].Drv[0].MCP23S17Io, kb->Btn[i].Drv[0].MCP23S17Port);
			printf("DrvP_M0_Cs: %d DrvP_M0_Io: %d MCP23S17_M0: %d \r\n", kb->Btn[i].Drv[1].MCP23S17Cs, kb->Btn[i].Drv[1].MCP23S17Io, kb->Btn[i].Drv[1].MCP23S17Port);
			printf("%d     ", i);       printf("DrvPx: %d  DrvPy: %d \r\n", kb->Btn[i].BtnC.AxisX, kb->Btn[i].BtnC.AxisY);
    }
	}
}



